## sandbox/esp32-bai/main/Kconfig.projbuild
```kconfig
menu "Bai hoc"
    choice BAI
        prompt "Chay bai nao"
        default BAI_9_1
        config BAI_8_3
            bool "8.3 GND chung: GPIO14 bat/tat S8050 moi 1s"
        config BAI_8_4
            bool "8.4 Tu loc: WiFi quet lien tuc de keo dong"
        config BAI_9_1
            bool "9.1 / 9.2 Nhay LED GPIO13"
        config BAI_9_3
            bool "9.3 / 9.5 Doc GPIO12, doi pull-up noi moi 10s"
        config BAI_9_4
            bool "9.4 Dem so lan nhan GPIO12: tho va chong doi"
        config BAI_9_7
            bool "9.7 UART vong lap: TX 10 -> 1k -> RX 11"
        config BAI_9_8
            bool "9.8 Ngat: nut GPIO12 hoi vong vs ngat + timer 1kHz"
        config BAI_9_6
            bool "9.6 In muc chan strapping va ly do reset"
        config BAI_10_1
            bool "10.1 / 10.4 ADC GPIO1: so tho + mV da hieu chuan"
        config BAI_10_2
            bool "10.2 Quang tro GPIO2 bat LED GPIO13 khi toi"
        config BAI_10_3
            bool "10.3 Do ap hop pin qua cau 10k+10k o GPIO1"
        config BAI_11_1
            bool "11.1 PWM chinh sang LED GPIO13"
        config BAI_11_2
            bool "11.2 PWM giu duty 25/50/75% moi muc 10s"
        config BAI_11_3
            bool "11.3 PWM motor qua S8050 o GPIO14"
        config BAI_11_4
            bool "11.4 Coi thu dong GPIO14 qua S8050: doi tan so"
        config BAI_12_1
            bool "12.1 / 12.4 I2C: quet dia chi + ve chu len OLED"
        config BAI_12_2
            bool "12.2 I2S: muc am mic INMP441"
        config BAI_12_3
            bool "12.3 I2S: phat tone 440Hz qua MAX98357A"
        config BAI_13_1
            bool "13.1 Cau H: doi chieu motor bang IN1/IN2"
        config BAI_13_2
            bool "13.2 Cau H + PWM: 2 chieu x 3 toc do"
        config BAI_13_3
            bool "13.3 Nhieu motor: nhay LED luc khoi dong + tang toc motor"
        config BAI_14_2
            bool "14.2 FC-51: GPIO8 bao co vat"
        config BAI_14_3
            bool "14.3 HC-SR04: Trig 17, Echo 18 (qua cau 10k/20k)"
        config BAI_14_4
            bool "14.4 TCRT5000: DO GPIO21 + AO GPIO2"
        config BAI_15_1
            bool "15.1 Servo SG90 GPIO14: 1 / 1.5 / 2ms"
        config BAI_15_2
            bool "15.2 Dem xung khe quang GPIO11 (PCNT) + motor DRV8833"
        config BAI_15_4
            bool "15.4 PI giu toc do banh (mach 15.2)"
        config BAI_15_3
            bool "15.3 MPU-6050: cong don gyro Z ra goc"
        config BAI_16_3
            bool "16.3 Do pin 2S GPIO1 (x3) + LED trang thai GPIO13"
        config BAI_17_1
            bool "17.1 Robot tranh vat"
        config BAI_18_1
            bool "18.1 So lieu qua WiFi len tram"
        config BAI_18_2
            bool "18.2 Vong dieu khien dung nhip (vTaskDelay / DelayUntil / printf)"
        config BAI_18_3
            bool "18.3 May trang thai ne vat"
        config BAI_18_4
            bool "18.4 Lai tu may tinh + dung khi mat ket noi"
        config BAI_19_1
            bool "19.1 Encoder 2 banh (GPIO11, 13)"
        config BAI_19_2
            bool "19.2 Di thang: vong ho / PI / PI + bu lech"
        config BAI_19_3
            bool "19.3 Odometry x, y, goc"
        config BAI_19_4
            bool "19.4 Tron gyro GY-521 vao goc"
        config BAI_19_5
            bool "19.5 Di toi diem, hinh vuong"
        config BAI_20_1
            bool "20.1 Bam vach 2 TCRT5000 (GPIO4, 5)"
        config BAI_20_2
            bool "20.2 Radar sieu am tren servo (GPIO15)"
        config BAI_20_3
            bool "20.3 Ve ban do: lai + quet radar"
        config BAI_20_4
            bool "20.4 Di phu kin kieu robot hut bui"
        config BAI_21
            bool "21.x Cau noi ROS 2 + LiDAR LD19 (GPIO16)"
    endchoice
endmenu

menu "Robot (Phan 4)"
    config ROBOT_WIFI_SSID
        string "WiFi SSID"
        default ""
        help
            Ten mang WiFi (2.4GHz) robot vao. Luu trong sdkconfig (khong dua len git).
    config ROBOT_WIFI_PASS
        string "WiFi mat khau"
        default ""
    config ROBOT_UM_MOI_XUNG
        int "Quang duong moi xung encoder (micromet)"
        default 5100
        help
            Banh 65mm, dia 20 lo dem 2 canh: 204mm / 40 = 5.1mm. Sua theo so do bai 19.1.
    config ROBOT_KHOANG_BANH_MM
        int "Khoang cach 2 banh (mm)"
        default 135
        help
            Do tu giua banh trai toi giua banh phai. Hieu chuan lai o bai 19.3.
    config ROBOT_TRON_GYRO_PHAN_NGHIN
        int "He so tron gyro x1000 (0 = chi encoder, 1000 = chi gyro)"
        range 0 1000
        default 998
    config ROBOT_SERVO_DAO
        bool "Dao chieu servo radar (goc duong phai la ben trai robot)"
        default n
endmenu
```
